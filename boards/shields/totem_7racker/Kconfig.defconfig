## boards/shields/totem_7racker/Kconfig.defconfig
```kconfig
# Copyright (c) 2020 The ZMK Contributors
# SPDX-License-Identifier: MIT

if SHIELD_TOTEM_7RACKER_DONGLE || SHIELD_TOTEM_7RACKER_LEFT

config ZMK_SPLIT_BLE_ROLE_CENTRAL
	default y

endif


if SHIELD_TOTEM_7RACKER_DONGLE

config ZMK_KEYBOARD_NAME
	default "totem.dongle"

endif


if SHIELD_TOTEM_7RACKER_LEFT

config ZMK_KEYBOARD_NAME
	default "totem.left.c"

endif


if SHIELD_TOTEM_7RACKER_LEFT_PERIPHERAL

config ZMK_KEYBOARD_NAME
	default "totem.left.p"

endif


if SHIELD_TOTEM_7RACKER_LEFT_RIGHT

config ZMK_KEYBOARD_NAME
	default "totem.right"

endif


if SHIELD_TOTEM_7RACKER_DONGLE || SHIELD_TOTEM_7RACKER_LEFT || SHIELD_TOTEM_7RACKER_LEFT_PERIPHERAL || SHIELD_TOTEM_7RACKER_RIGHT 

config ZMK_SPLIT
	default y

config SPI
    default y

endif
```

## boards/shields/totem_7racker/Kconfig.shield
```kconfig
# Copyright (c) 2020 The ZMK Contributors
# SPDX-License-Identifier: MIT

config SHIELD_TOTEM_7RACKER_DONGLE
	def_bool $(shields_list_contains,totem_7racker_dongle)

config SHIELD_TOTEM_7RACKER_LEFT
	def_bool $(shields_list_contains,totem_7racker_left)

config SHIELD_TOTEM_7RACKER_LEFT_PERIPHERAL
	def_bool $(shields_list_contains,totem_7racker_left_peripheral)

config SHIELD_TOTEM_7RACKER_RIGHT
	def_bool $(shields_list_contains,totem_7racker_right)
```
