/*
 * Copyright (c) 2020 The ZMK Contributors
 *
 * SPDX-License-Identifier: MIT
 */

#include "totem_7racker.dtsi"

/delete-node/ &kscan0;

/ {
    chosen {
        zmk,kscan = &mock_kscan;
    };

    mock_kscan: kscan1 {
        compatible = "zmk,kscan-mock";
        columns = <0>;
        rows = <0>;
        events = <0>;
    };
};